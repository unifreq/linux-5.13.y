// SPDX-License-Identifier: (GPL-2.0+ OR MIT)
/*
 * Copyright (c) 2019 BayLibre SAS. All rights reserved.
 * Copyright (c) 2020 Christian Hewitt <christianshewitt@gmail.com>
 * Copyright (c) 2021 flippy <uniqfreq@gmail.com>
 */

/dts-v1/;

#include "meson-sm1-x96-max-plus.dts"

&external_phy {
	icplus,select-interrupt;
};

